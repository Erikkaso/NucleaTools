## wake-word/esp32_wakeword/main/Kconfig.projbuild
```kconfig
menu "Nuclea device audio"

    config NUCLEA_SPEAKER_ENABLED
        bool "Play streaming responses through MAX98357A on I2S1"
        default y
        help
            Request responseMode=speaker on the same device-audio POST.
            Disable to retain the browser mailbox response mode.

    config NUCLEA_RECORDING_SFX_ENABLED
        bool "Play local recording start/stop sound effects"
        depends on NUCLEA_SPEAKER_ENABLED
        default y
        help
            Play onsfx after wakeword acceptance, before recording the command.
            Play offsfx after recording stops, before the HTTP request.

    config NUCLEA_SPEAKER_BCLK_GPIO
        int "MAX98357A BCLK GPIO"
        depends on NUCLEA_SPEAKER_ENABLED
        range 0 48
        default 14

    config NUCLEA_SPEAKER_WS_GPIO
        int "MAX98357A LRC/WS GPIO"
        depends on NUCLEA_SPEAKER_ENABLED
        range 0 48
        default 21

    config NUCLEA_SPEAKER_DIN_GPIO
        int "MAX98357A DIN GPIO (ESP TX)"
        depends on NUCLEA_SPEAKER_ENABLED
        range 0 48
        default 13

    config NUCLEA_SPEAKER_VOLUME_PERCENT
        int "Speaker digital volume (percent)"
        depends on NUCLEA_SPEAKER_ENABLED
        range 0 100
        default 100

    config NUCLEA_SPEAKER_BOOST_DB
        int "Speaker loudness boost before the limiter (dB)"
        depends on NUCLEA_SPEAKER_ENABLED
        range 0 12
        default 6
        help
            Raises quiet and average speech; the limiter keeps peaks under
            NUCLEA_SPEAKER_LIMIT_DBFS. More boost sounds louder but more compressed.

    config NUCLEA_SPEAKER_LIMIT_DBFS
        int "Speaker peak limiter ceiling (dBFS)"
        depends on NUCLEA_SPEAKER_ENABLED
        range -12 0
        default -3
        help
            Highest digital peak sent to the MAX98357A. Lower it if the amplifier
            or the 5 V supply still distorts on loud syllables.

    config NUCLEA_SPEAKER_HIGHPASS_HZ
        int "Speaker high-pass cutoff (Hz, 0 disables)"
        depends on NUCLEA_SPEAKER_ENABLED
        range 0 400
        default 150
        help
            Removes bass a small speaker cannot reproduce; it would only use
            amplifier headroom and make the cone distort.

    config NUCLEA_DEVICE_ID
        string "Device session ID"
        default "nuclea-esp32"

    config NUCLEA_SILENCE_DBFS
        int "Fallback activity threshold in dBFS (no wakeword reference)"
        range -90 0
        default -32
        help
            Normal recordings use the wakeword RMS and measured idle noise floor.
            This value is only used if the wakeword reference is unavailable.

    config NUCLEA_SILENCE_MS
        int "Activity extension after last loud audio (ms)"
        range 500 10000
        default 1500

    config NUCLEA_MIN_RECORDING_MS
        int "Base recording duration including pre-roll (ms)"
        range 1000 12000
        default 3000

    config NUCLEA_MAX_RECORDING_MS
        int "Maximum recording duration (ms)"
        range 5000 12000
        default 12000

endmenu

menu "Nuclea robot display"
    config NUCLEA_DISPLAY_ONLY_TEST
        bool "Test display only on GPIOs 4/5/6/7/15"
        depends on NUCLEA_DISPLAY_ENABLED
        default n
        help
            Skip microphone, speaker, Wi-Fi and wakeword initialization.
            Cycle sleep and awake animations automatically. Disconnect other
            peripherals that share these GPIOs before using this test.

    config NUCLEA_DISPLAY_ENABLED
        bool "Enable ST7789 robot animations (rewire microphone first)"
        default y

    config NUCLEA_DISPLAY_IDLE_MS
        int "Awake time after request completes (ms)"
        range 1000 300000
        default 30000

    config NUCLEA_DISPLAY_SPI_MHZ
        int "Display SPI clock (MHz)"
        range 10 40
        default 40

    config NUCLEA_DISPLAY_X_GAP
        int "Panel horizontal offset in landscape orientation"
        range 0 40
        default 20

    config NUCLEA_DISPLAY_Y_GAP
        int "Panel vertical offset in landscape orientation"
        range 0 80
        default 0

    config NUCLEA_PIEZO_ENABLED
        bool "Read a piezo shake sensor"
        depends on NUCLEA_DISPLAY_ENABLED && !NUCLEA_DISPLAY_ONLY_TEST
        default y
        help
            Counts piezo pulses with PCNT and feeds the shake reactions.
            On GPIO 19/20 the native USB port stops working; flash and
            monitor through the UART port.

    config NUCLEA_PIEZO_GPIO
        int "Piezo GPIO"
        depends on NUCLEA_PIEZO_ENABLED
        range 0 48
        default 1

    config NUCLEA_PIEZO_PULLDOWN
        bool "Enable internal pull-down (no external 1 Mohm resistor)"
        depends on NUCLEA_PIEZO_ENABLED
        default n

    config NUCLEA_PIEZO_KNOCK_MODE
        bool "Trigger on a knock pattern instead of continuous shaking"
        depends on NUCLEA_PIEZO_ENABLED
        default n
        help
            For weak wiring (series resistor plus internal pull-down) where a
            knock yields only one or two pulses. Disable after adding a 1 Mohm
            resistor across the piezo to use continuous shake detection.

    config NUCLEA_PIEZO_KNOCKS
        int "Knocks needed to trigger a reaction"
        depends on NUCLEA_PIEZO_KNOCK_MODE
        range 1 8
        default 3

    config NUCLEA_PIEZO_KNOCK_WINDOW_MS
        int "All knocks must happen within (ms)"
        depends on NUCLEA_PIEZO_KNOCK_MODE
        range 300 10000
        default 2000

    config NUCLEA_PIEZO_SHAKE_BUCKETS
        int "Consecutive 100 ms periods of shaking needed"
        depends on NUCLEA_PIEZO_ENABLED && !NUCLEA_PIEZO_KNOCK_MODE
        range 2 50
        default 4
        help
            Shaking must last this many 100 ms periods (4 = 0.4 s) with a
            single quiet period tolerated. Higher = less sensitive.

    config NUCLEA_PIEZO_MIN_PULSES
        int "Pulses per 100 ms period needed to count as movement"
        depends on NUCLEA_PIEZO_ENABLED && !NUCLEA_PIEZO_KNOCK_MODE
        range 1 200
        default 60
        help
            Sparse noise at rest produces fewer pulses than this and is
            ignored. Higher = less sensitive. Measured on the board: idle
            interference bursts reach ~460 pulses/s, real shaking 1000-2000/s (100-200 per period).
endmenu

menu "Nuclea microphone pins"
    config NUCLEA_MIC_BCLK_GPIO
        int "INMP441 SCK/BCLK GPIO"
        range 0 48
        default 41

    config NUCLEA_MIC_WS_GPIO
        int "INMP441 WS GPIO"
        range 0 48
        default 42

    config NUCLEA_MIC_SD_GPIO
        int "INMP441 SD GPIO"
        range 0 48
        default 40
endmenu
```

## wake-word/esp32_wakeword/sdkconfig.defaults
```kconfig
CONFIG_ESPTOOLPY_FLASHSIZE_16MB=y
CONFIG_ESPTOOLPY_FLASHSIZE="16MB"
CONFIG_ESPTOOLPY_HEADER_FLASHSIZE_UPDATE=y
CONFIG_ESP_MAIN_TASK_STACK_SIZE=16384
CONFIG_SPIRAM=y
CONFIG_SPIRAM_MODE_OCT=y
CONFIG_SPIRAM_SPEED_80M=y
CONFIG_SPIRAM_USE_CAPS_ALLOC=y
CONFIG_PARTITION_TABLE_CUSTOM=y
CONFIG_PARTITION_TABLE_CUSTOM_FILENAME="partitions.csv"
CONFIG_NUCLEA_DISPLAY_ENABLED=y
CONFIG_ESP_DEFAULT_CPU_FREQ_MHZ_240=y
CONFIG_NUCLEA_MIN_RECORDING_MS=3000
CONFIG_NUCLEA_SILENCE_MS=1500
CONFIG_NUCLEA_MAX_RECORDING_MS=12000
CONFIG_NUCLEA_SPEAKER_VOLUME_PERCENT=100
CONFIG_NUCLEA_SPEAKER_BOOST_DB=6
CONFIG_NUCLEA_SPEAKER_LIMIT_DBFS=-3
CONFIG_NUCLEA_SPEAKER_HIGHPASS_HZ=150
CONFIG_NUCLEA_PIEZO_ENABLED=y
CONFIG_NUCLEA_PIEZO_GPIO=1
# CONFIG_NUCLEA_PIEZO_KNOCK_MODE is not set
CONFIG_NUCLEA_PIEZO_SHAKE_BUCKETS=4
CONFIG_NUCLEA_PIEZO_MIN_PULSES=60
# CONFIG_NUCLEA_PIEZO_PULLDOWN is not set
```
